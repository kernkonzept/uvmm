/**
 * Devic tree for purely virtual guests on the MIPS architecture.
 */

/dts-v1/;

#if __SIZEOF_POINTER__ == 4
/include/ "skeleton.dtsi"
#else
/include/ "skeleton64.dtsi"
#endif


/include/ "ic-mips.dtsi"
/include/ "vmm-devices-mips.dtsi"
/include/ "syscon.dtsi"

/ {
    model = "L4 VM";
    compatible = "l4,virt", "linux,dummy-virt";

#if __SIZEOF_POINTER__ == 8
    l4vmm {
        ranges = <0x0  0x0 0x30000000  0x21000>;
    };

    soc {
        ranges = <0x0  0x0 0x0  0xffffffff>;
    };

    syscon {
        ranges = <0x0  0x0 0x30030000  0x4>;
    };
#endif
};
